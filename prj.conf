## CMakeLists.txt
```
# Copyright (c) 2020 Abhijit Bose <https://boseji.com>
# SPDX-License-Identifier: Apache-2.0

cmake_minimum_required(VERSION 3.13.1)
find_package(Zephyr REQUIRED HINTS $ENV{ZEPHYR_BASE})
project(basic_blinky_stm32f3_disco)

target_sources(app PRIVATE src/main.c)
```

## prj.conf
```kconfig
CONFIG_DEBUG=y
```

## src/main.c
```c
/*
 * Copyright (c) 2020 Abhijit Bose <https://boseji.com>
 *
 * SPDX-License-Identifier: Apache-2.0
 */

#include <device.h>
#include <devicetree.h>
#include <drivers/gpio.h>
#include <zephyr.h>

void main(void) {
  struct device *gpioe;

  /* Get instance of GPIOE */
  gpioe = device_get_binding("GPIOE");
  if (gpioe == NULL) {
    return;
  }

  /* Enabled Pins for Output */
  if (gpio_pin_configure(gpioe, 9, GPIO_OUTPUT_ACTIVE) < 0) {
    return;
  }

  /* Start the Infinite Loop */
  while (1) {
    gpio_pin_toggle(gpioe, 9);
    /* Wait for 1 Second = 1000mS */
    k_msleep(1000);
  }
}
```
